## external/Config.in
```kconfig
menu "Nocturne options"
    # hi
endmenu

menu "Nocturne packages"
    source "$BR2_EXTERNAL_Nocturne_PATH/package/stock-blobs/Config.in"
    source "$BR2_EXTERNAL_Nocturne_PATH/package/static-web-server/Config.in"
    source "$BR2_EXTERNAL_Nocturne_PATH/package/nocturned/Config.in"
    source "$BR2_EXTERNAL_Nocturne_PATH/package/nocturne-ui/Config.in"
endmenu
```

## image/external/package/fastfetch/Config.in
```kconfig
config BR2_PACKAGE_FASTFETCH
    bool "fastfetch"
    select BR2_PACKAGE_CJSON
    help
      fastfetch with Nocturne configuration.
```

## image/external/package/nocturne-ui/Config.in
```kconfig
config BR2_PACKAGE_NOCTURNE_UI
    bool "Nocturne UI"
    help
      Nocturne UI files.
```

## image/external/package/nocturned/Config.in
```kconfig
config BR2_PACKAGE_NOCTURNED
    bool "nocturned (private)"
    depends on BR2_PACKAGE_HOST_RUSTC_TARGET_ARCH_SUPPORTS
    select BR2_PACKAGE_HOST_RUSTC
    help
      Nocturne daemon (private).
```

## image/external/package/static-web-server/Config.in
```kconfig
config BR2_PACKAGE_STATIC_WEB_SERVER
    bool "static-web-server"
    help
      Static web server for nocturne-ui.
```

## image/external/package/stock-blobs/Config.in
```kconfig
config BR2_PACKAGE_STOCK_BLOBS
    bool "Install stock blobs"
	  depends on BR2_INSTALL_LIBSTDCPP
    help
      Uses stock binaries for GPU, Weston, Chromium, etc.
      Must first run ./external/packages/stock-blobs/fetch-stock.sh
      to populate dl/stock-blobs/.

comment "stock blobs needs a toolchain w/ C++"
	depends on !BR2_INSTALL_LIBSTDCPP
```

## image/meta-nocturne/conf/layer.conf
```bitbake
BBPATH .= ":${LAYERDIR}"
NOCTURNE_LAYERDIR := "${LAYERDIR}"

BBFILES += "${LAYERDIR}/recipes-*/*/*.bb \
            ${LAYERDIR}/recipes-*/*/*.bbappend"

BBFILE_COLLECTIONS += "nocturne"
BBFILE_PATTERN_nocturne = "^${LAYERDIR}/"
BBFILE_PRIORITY_nocturne = "20"

LAYERSERIES_COMPAT_nocturne = "scarthgap wrynose"

LAYERDEPENDS_nocturne = "core superbird"
```
